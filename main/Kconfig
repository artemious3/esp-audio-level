## main/Kconfig
```kconfig
menu "esp-eq configuration"
	config GPIO_BT_STATE_LED
		int "Number of GPIO pin, connected to led, that indicates bluetooth state (connected/disconnected)"
		default 2

	config GPIO_MUSIC_LED 
		int "Number of GPIO pin, connected to led, that blinks to the rythm of music"
		default 4

	config NUM_CB_TO_CALCULATE_AVG 
		int "Number of average samples per last data callbacks stored to calculate current average"
		default 32

	
	config GPIO_I2C_SDA
		int "I2C SDA pin"
		default 21

	config GPIO_I2C_SCL
		int "I2C SCL pin"
		default 22

	config SSD1306_V_RES
		int "Height of SSD1306 display"
		default 64

	config SSD1306_H_RES
		int "Width of SSD1306 display"
		default 128

endmenu
```
